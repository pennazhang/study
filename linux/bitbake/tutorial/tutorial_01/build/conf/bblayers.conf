## linux/bitbake/tutorial/tutorial_01/build/conf/bblayers.conf
```bitbake
BBPATH := "${TOPDIR}" 
BBFILES ?= ""
BBLAYERS = "/git/study/linux/bitbake/tutorial/tutorial_01/meta-tutorial"
```

## linux/bitbake/tutorial/tutorial_04/meta-tutorial/conf/layer.conf
```bitbake
BBPATH .= ":${LAYERDIR}"
BBFILES += "${LAYERDIR}/recipes-*/*/*.bb" 

BBFILE_COLLECTIONS += "tutorial"
BBFILE_PATTERN_tutorial = "^${LAYERDIR}/"
BBFILE_PRIORITY_tutorial = "5"
LAYERVERSION_tutorial = "1"
 
```

## linux/bitbake/tutorial/tutorial_05/build/conf/bblayers.conf
```bitbake
BBPATH := "${TOPDIR}" 
BBFILES ?= ""

BBLAYERS = " \
  ${TOPDIR}/../meta-tutorial \
  ${TOPDIR}/../meta-two \
" 
```
